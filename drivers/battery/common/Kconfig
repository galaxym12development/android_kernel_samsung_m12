## drivers/battery/common/Kconfig
```kconfig
# Samsung battery configuration
#

menu "Samsung battery support"

config BATTERY_SAMSUNG
	tristate "samsung battery driver"
	help
	  Say Y to include support for samsung battery driver
	  This battery driver integrated all battery-related functions
	  To see battery-related functions,
	  refer to sec_charging_common.h

if BATTERY_SAMSUNG

config BATTERY_SAMSUNG_LEGO_STYLE
	tristate "samsung battery driver (lego style)"
	default n
	depends on BATTERY_SAMSUNG
	help
	 Say Y to include support for samsung battery driver
	 This battery driver integrated all battery-related functions
	 To see battery-related functions,
	 refer to sec_charging_common.h

config BATTERY_SAMSUNG_MHS
	tristate "samsung battery driver for mhs model"
	default n
	depends on BATTERY_SAMSUNG_V2
	help
	 Say Y to include support for samsung battery driver
	 This battery driver integrated all battery-related functions
	 To see battery-related functions,
	 refer to sec_charging_common.h

config CHARGING_VZWCONCEPT
	tristate "VZW concept about the charging"
	default n
	depends on BATTERY_SAMSUNG
	help
	 Say Y to include support for the VZW concepts.

config MULTI_CHARGING
	bool "support for multi charger ICs"
	help
	 Say Y to include support for multi charger ICs

config STEP_CHARGING
	bool "support for step charging"
	help
	 Say Y to include support for step charging

config ENABLE_FULL_BY_SOC
	bool "make full by soc 100%"
	help
	default n
	 Say Y to include support to make full by soc 100%

config UPDATE_BATTERY_DATA
	bool "support for updating battery data"
	default n
	depends on BATTERY_SAMSUNG && OF
	help
	 Say Y to include support for step charging

config BATTERY_CISD
	 bool "support for cisd"
	 help
	 Say Y to include support for cisd
	 cisd means cell internal short detection

config CS100_JPNCONCEPT
	tristate "cs100 command support"
	depends on BATTERY_SAMSUNG && I2C
	help
	 Say Y here to support for CS100 command to stop when full-charged
	 on wireless charging for JPN models

config AFC_CHARGER_MODE
	bool "afc charging support in sec battery driver"
	default n
	help
	  Say Y to include support for sec afc charging support

config SAMSUNG_BATTERY_FACTORY
	bool "enable for factory test"
	default n
	help
	  Say Y to include support for factory test
	  enable this feature only factory mode
	  this featuren must disabled user binary
	  stability test etc..

config SAMSUNG_BATTERY_DISALLOW_DEEP_SLEEP
	bool "Disallow deep sleep during charging"
	default n
	depends on BATTERY_SAMSUNG && (ARCH_MSM8974 || ARCH_APQ8084)
	help
	  Say Y to include support
	  Disallow deep sleep during charging for stablity.

config DISABLE_SAVE_CAPACITY_MAX
	bool "Disable to save capacity max in efs"
	default n
	depends on BATTERY_SAMSUNG
	help
		Say Y to include support to disable it
		capacity_max is saved in /efs/Battery/batt_capacity_max
		capacity_max is restored after boot up
		You can find the code in healthd

config EN_OOPS
	bool "enable oops filter"
	default n
	help
	  Say Y to enable oops filter

config USE_POGO
	bool "enable pogo charging"
	default n
	help
	  Say Y to enable CONFIG_USE_POGO

config DISCRETE_CHARGER
	bool "enable discrete charger"
	default n
	help
	  Say Y to enable CONFIG_USE_CHARGER
	  This feature is used for models that have a
	  dedicated charger IC or in-PMIC charger.
	  It is needed to separate concepts in the battery driver.

config STORE_MODE
	bool "enable store mode"
	default n
	help
	  Say Y to enable CONFIG_STORE_MODE

config BATTERY_AGE_FORECAST
	tristate "battery age forecast"
	default n
	help
	  Say Y to use calc time to full function.

config BATTERY_AGE_FORECAST_DETACHABLE
	tristate "battery age forecast for detachable"
	default n
	select BATTERY_AGE_FORECAST
	help
	Say Y to use battery age forecast for detachable

config BATTERY_AGE_FORECAST_B2B
	tristate "battery age forecast for B2B"
	default n
	select BATTERY_AGE_FORECAST
	help
	Say Y to use battery age forecast for B2B

config BATTERY_LOGGING
	tristate "battery logging"
	default n
	depends on BATTERY_SAMSUNG
	help
	Say Y to use update battery logging

config ENG_BATTERY_CONCEPT
       bool "enable temp block"
       default n
       help
	 Say Y to enable CONFIG_ENG_BATTERY_CONCEPT

config USB_FACTORY_MODE
	bool "enable USB factory mode"
	default n
	help
	  Say Y to enable CONFIG_USB_FACTORY_MODE
	  This feature is used for models that support
	  factory mode using USB cable instead of Anyway JIG.
	  Code for this is added in charger and battery driver.

config BATTERY_NOTIFIER
	bool "battery notifier"
	default n
	help
	  Say Y to enable battery notifier

config LIMIT_CHARGING_DURING_CALL
	bool "limit charging during call"
	default n
	help
	  Say Y to limit charging during call

config TABLET_MODEL_CONCEPT
	bool "tablet model concept"
	default n
	help
	  Say Y to enable tablet model concept

config DUAL_BATTERY
    tristate "DUAL BATTERY support"
    depends on I2C
    help
	  Say Y here to enable support for dual battery

config ISDB_CHARGING_CONTROL
    tristate "ISDB CHARGING CONTROL support"
    depends on I2C
    help
	  Say Y here to enable support for isdb

config PREVENT_USB_CONN_OVERHEAT
    bool "enable prevent usb conn overheat"
    default n
    help
	  Say Y to enable CONFIG_PREVENT_USB_CONN_OVERHEAT

endif

config SUPPORT_HV_CTRL
    bool "support for controlling voltage"
    default n
    help
	  Say Y to include support for controlling voltage

config SUPPORT_WAKEUP_REGISTER
    bool "support for wakeup register api based on kernel version"
    default n
    help
	  Say Y to enable CONFIG_SUPPORT_WAKEUP_REGISTER
	  This feature is used for kernel wakeup api and
	  old kernel version do not support wakeup register api.
	  Please check pm_wakeup header in your kernel before enable this.

endmenu
```

## drivers/media/platform/exynos/camera/sensor/module_framework/Kconfig
```kconfig
source "drivers/media/platform/exynos/camera/sensor/module_framework/cis/Kconfig"
source "drivers/media/platform/exynos/camera/sensor/module_framework/actuator/Kconfig"
source "drivers/media/platform/exynos/camera/sensor/module_framework/flash/Kconfig"
```

## drivers/misc/samsung/Kconfig
```kconfig
source "drivers/misc/samsung/scsc/Kconfig"
source "drivers/misc/samsung/scsc_bt/Kconfig"
```

## drivers/nfc/Kconfig
```kconfig
#
# Near Field Communication (NFC) devices
#
config SAMSUNG_NFC
	tristate "Samsung NFC driver for module build"
	default n
	help
	  Say Y here if you want to build support for NFC (Near field
	  communication) devices.
	  To compile this support as a module, choose M here: the module will
	  be called nfc.

config SEC_NFC
	bool "Samsung NFC driver"
	default n
	help
	  SAMSUNG NFC Driver.
	  This driver provides support for SAMSUNG NFC products.
	  You should select your NFC product and interface.

	  Say Y here to compile support for SAMSUNG NFC driver into the
	  kernel.

config NFC_PVDD_LATE_ENABLE
        bool "PVDD late enable"
        default n
        help
          If lpcharge value is not usable,
          then PVDD is enabled lately by init.nfc.samsung.rc on late-init.
          And this should be enabled from S os projects.

config ESE_P3_LSI
	bool "eSE driver"
	depends on SPI
	default n
	help
	  This option enables the NFC driver for Texas Instruments' TRF7970a
	  device. Such device supports 5 different protocols: ISO14443A,
	  ISO14443B, FeLiCa, ISO15693 and ISO18000-3.

	  Say Y here to compile support for TRF7970a into the kernel or
	  say M  to compile it as a module. The module will be called
	  trf7970a.ko.

config ESE_COLDRESET
	bool "eSE support coldreset"
	depends on ESE_P3_LSI
	default n
	help
	  This adds support to use an mei bus nfc device. Select this if you
	  will use an HCI NFC driver for an NFC chip connected behind an
	  Intel's Management Engine chip.

	  If unsure, say N.

config NFC_SIM
	tristate "NFC hardware simulator driver"
	depends on NFC_DIGITAL
	help
	  This driver declares two virtual NFC devices supporting NFC-DEP
	  protocol. An LLCP connection can be established between them and
	  all packets sent from one device is sent back to the other, acting as
	  loopback devices.

	  If unsure, say N.

config NFC_PORT100
	tristate "Sony NFC Port-100 Series USB device support"
	depends on USB
	depends on NFC_DIGITAL
	help
	  This adds support for Sony Port-100 chip based USB devices such as the
	  RC-S380 dongle.

config ESE_SECURE
	bool "ESE Secure Controller Driver"
	depends on !SEC_FACTORY
	default n
	help
	  Common eSE Secure controller support.
	  This option enables device driver support for the eSE with NFC.
	  It is used by many services. eSE is fully controlled using SPI
	  to communication

config ESE_USE_TZ_API
        bool "use tz api"
        default n
        help
          Enable when using TZ API.

config SEC_NFC_LOGGER
	bool "NFC logger"
	default n
	help
	  Enable NFC log.
	  NFC log will be recorded at proc folder.
	  but will not included at dumpstate log.
	  so need to copy this file to log folder.

config SEC_NFC_DUPLICATED_IRQ_WQ_LSI
	bool "NFC duplicated irq wq lsi"
	default n
	help
	  Enable NFC duplicated irq LSI w/a.
	  If the interrupt occurs twice continuously, the i2c_info.
	  read_irq value is returned to the previous value.
	  Apply W/A received from LSI

config SEC_NFC_DUPLICATED_IRQ_WQ_QC
	bool "NFC duplicated irq wq qc"
	default n
	help
	  Enable NFC duplicated irq QC solution.
	  add the IRQF_NO_SUSPEND flag during interrupt registration
	  and do not use enable_irq_wake() api to configure the GPIO
	  as wakeup capable.

config SEC_NFC_WAKELOCK_METHOD
        int "nfc wakelock method"
        default 0
        help
          Different functions must be used depending on the kernel version
          for wakelock initialization.
          0 - auto selection
          1 - wakeup_source_init
          2 - wakeup_source_register

config NFC_PN547
	bool "NXP PN547 NFC Controller Driver"
	depends on I2C
	default n
	help
	  NXP PN547 Near Field Communication controller support.
	  This option enables device driver support for the NFC.
	  It is used by many services. NFC is fully controlled using I2C
	  to communication.

config NFC_FEATURE_SN100U
	bool "NXP SN100U Feature"
	default n
	help
	  NXP SN100U Near Field Communication controller support
	  This option enables device driver support for the NFC.
	  It is used by many services. NFC is fully controlled using I2C
	  to communicate the AP chip.

config NFC_PN547_ESE_SUPPORT
	bool "NXP PN547 ESE SUPPORT"
	depends on NFC_PN547
	default n
	help
	  NXP PN547 Near Field Communication controller support.
	  This option enables device driver support for the NFC.
	  It is used by many services. NFC is fully controlled using I2C
	  to communication

config SEC_NFC_LOGGER
        bool "NFC logger"
        default n
        help
          Enable NFC log.
          NFC log will be recorded at proc folder.
          but will not included at dumpstate log.
          so need to copy this file to log folder.

config SEC_NFC_LOGGER_ADD_ACPM_LOG
        bool "NFC logger: add acpm log"
        default n
        depends on SEC_NFC_LOGGER
        help
          add acpm log.
          this feature is for particualr AP.
          rtc reg addr is needed to compare time

config SEC_NFC_LOGGER_RTC_REG_ADDR
        hex "NFC logger: add acpm log"
        default 0x0
        depends on SEC_NFC_LOGGER_ADD_ACPM_LOG
        help
          RTC time is to compare between acpm and kernel.
          address value is hex.

config SEC_STAR
        tristate "LSI star platform"
        default n
        help
          LSI star platform
          This driver provides support for LSI star platform.

config STAR_K250A
        bool "S.LSI k250a driver"
        help
          S.LSI k250a driver except ISO7816 protocol layer
          This driver provides support for S.LSI k250a product.
```

## drivers/soc/samsung/acpm/Kconfig
```kconfig
#
# ACPM driver configuration
#

menuconfig EXYNOS_ACPM
	bool "ACPM driver support"
	default n
	help
	  Enable ACPM support

if EXYNOS_ACPM

config EXYNOS_ACPM_MFD
	bool "EXYNOS_ACPM_MFD support"
	default y
	help
	  Enable ACPM_MFD support

config EXYNOS_ACPM_S2D
	bool "EXYNOS_ACPM_S2D support"
	help
	  Enable ACPM_S2D support

endif
```

## drivers/soc/samsung/m12-model/Kconfig
```kconfig
config M12_MODEL_OVERLAY
	bool "Galaxy M12 per-model device tree overlay"
	depends on SOC_EXYNOS3830
	select OF_OVERLAY
	help
	  Apply the device tree overlay of the model named by
	  androidboot.em.model on top of the common M12 DTBO.
```

## drivers/video/fbdev/exynos/dpu30/panels/Kconfig
```kconfig
config EXYNOS_COMMON_PANEL
	depends on EXYNOS_DPU30
	select BACKLIGHT_CLASS_DEVICE
	default n
	bool "Support Exynos Common Panel Driver"
```
